## components/lora/Kconfig
```kconfig
menu "LoRa (Ebyte E22-900T30D)"

config LORA_TX_POWER_DBM
    int "TX power (dBm)"
    default 21
    range 21 30
    help
        Transmit power: 21, 24, 27, or 30 dBm.
        21 dBm (~160 mA) is safe on the ESP32 3.3 V rail.
        30 dBm (~500 mA) requires a dedicated supply.

config LORA_CHANNEL
    int "RF channel (0–83)"
    default 52
    range 0 83
    help
        Frequency = 850.125 + channel MHz.
        Channel 52 = 902.125 MHz (US 900 MHz ISM band).

endmenu
```

## main/Kconfig.projbuild
```kconfig
menu "RTK GNSS"

choice ROVER_CORRECTION_SOURCE
    prompt "Rover RTCM correction source"
    default ROVER_CORRECTION_NTRIP
    help
        Selects how the rover receives RTCM3 differential corrections.
        NTRIP: WiFi connection to an internet caster (RTK2Go, state CORS, etc.)
        LoRa:  Local base station broadcasting over the LoRa radio link.

    config ROVER_CORRECTION_NTRIP
        bool "NTRIP caster (WiFi)"

    config ROVER_CORRECTION_LORA
        bool "Local base via LoRa"

endchoice

config WIFI_SSID
    string "WiFi SSID"
    default "myssid"
    depends on ROVER_CORRECTION_NTRIP

config WIFI_PASSWORD
    string "WiFi password"
    default "mypassword"
    depends on ROVER_CORRECTION_NTRIP

config NTRIP_HOST
    string "NTRIP caster host"
    default "caster.rtk2go.com"
    depends on ROVER_CORRECTION_NTRIP

config NTRIP_PORT
    int "NTRIP caster port"
    default 2101
    range 1 65535
    depends on ROVER_CORRECTION_NTRIP

config NTRIP_MOUNTPOINT
    string "NTRIP mountpoint"
    default ""
    depends on ROVER_CORRECTION_NTRIP

config NTRIP_USER
    string "NTRIP username (email address for RTK2go)"
    default ""
    depends on ROVER_CORRECTION_NTRIP
    help
        For RTK2go, enter your email address here. RTK2go requires a valid
        email as the username and will disconnect clients that do not provide one.
        No registration is needed — the email is only used for problem notifications.

config NTRIP_PASSWORD
    string "NTRIP password (use 'none' for RTK2go)"
    default "none"
    depends on ROVER_CORRECTION_NTRIP
    help
        For RTK2go, enter 'none' — the password field is ignored by their caster.
        For other casters, enter the actual password.

endmenu
```

## sdkconfig.defaults
```kconfig
# Disable the USB-OTG stack to save flash/RAM.
# NOTE: GPIO 15-20 remain reserved by the USB Serial/JTAG peripheral
# (used for idf.py monitor) regardless of this setting.  Use GPIO 14
# for UART TX — it is the first pin below that reserved range.
CONFIG_TINYUSB_ENABLED=n

# Rover receives RTCM corrections from the local LoRa base, not NTRIP.
# Switch to CONFIG_ROVER_CORRECTION_NTRIP=y to revert to internet caster.
CONFIG_ROVER_CORRECTION_LORA=y
```
