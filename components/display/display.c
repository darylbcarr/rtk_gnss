#include "display.h"
#include "driver/i2c_master.h"
#include "esp_log.h"
#include <string.h>
#include <stdio.h>
#include <stdarg.h>

static const char *TAG = "display";

#define SSD1306_W  128
#define SSD1306_H   64
#define SSD1306_PAGES (SSD1306_H / 8)   /* 8 */

#define FONT_W  5   /* glyph columns */
#define FONT_SP 1   /* inter-character spacing */
#define CHAR_W  (FONT_W + FONT_SP)  /* 6 px per character */

static i2c_master_dev_handle_t s_dev;
static i2c_master_bus_handle_t s_bus;
static uint8_t s_fb[SSD1306_PAGES][SSD1306_W];   /* framebuffer */

/* ── 5×8 ASCII font (columns, bit-0 = top pixel) ────────────────────── */
/* 96 printable characters: 0x20 (space) … 0x7F */
static const uint8_t s_font[96][FONT_W] = {
    { 0x00,0x00,0x00,0x00,0x00 },  /* 0x20  */
    { 0x00,0x00,0x5F,0x00,0x00 },  /* 0x21 ! */
    { 0x00,0x07,0x00,0x07,0x00 },  /* 0x22 " */
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    { 0x78,0x46,0x41,0x46,0x78 },  /* 0x7F DEL (unused placeholder) */
};

/* ── SSD1306 I2C helpers ─────────────────────────────────────────────── */

static esp_err_t oled_cmd(const uint8_t *cmds, size_t n)
{
    /* I2C write: [0x00, cmd0, cmd1, ...] — control byte 0x00 = command stream */
    uint8_t buf[32];
    if (n > sizeof(buf) - 1) return ESP_ERR_INVALID_ARG;
    buf[0] = 0x00;
    memcpy(buf + 1, cmds, n);
    return i2c_master_transmit(s_dev, buf, n + 1, 100);
}

static const uint8_t s_init_seq[] = {
    0xAE,        /* display off                */
    0xD5, 0x80,  /* oscillator / clock div     */
    0xA8, 0x3F,  /* multiplex ratio: 64 rows   */
    0xD3, 0x00,  /* display offset: 0          */
    0x40,        /* display start line: 0      */
    0x8D, 0x14,  /* SSD1306 charge pump: enable */
    0xAD, 0x8B,  /* SH1106 DC-DC pump: enable  */
    0xA1,        /* segment remap (mirror X)   */
    0xC8,        /* COM scan direction (flip Y)*/
    0xDA, 0x12,  /* COM pins config            */
    0x81, 0xCF,  /* contrast                   */
    0xD9, 0xF1,  /* pre-charge period          */
    0xDB, 0x40,  /* VCOMH deselect level       */
    0xA4,        /* follow RAM content         */
    0xA6,        /* normal (non-inverted)      */
    0xAF,        /* display on                 */
};

/* ── Public API ──────────────────────────────────────────────────────── */

esp_err_t display_init(i2c_master_bus_handle_t bus, uint8_t i2c_addr)
{
    s_bus = bus;
    i2c_device_config_t dev_cfg = {
        .dev_addr_length = I2C_ADDR_BIT_LEN_7,
        .device_address  = i2c_addr,
        .scl_speed_hz    = 50000,   /* 50 kHz — generous margin for breadboard */
    };
    ESP_ERROR_CHECK(i2c_master_bus_add_device(bus, &dev_cfg, &s_dev));

    esp_err_t ret = oled_cmd(s_init_seq, sizeof(s_init_seq));
    if (ret != ESP_OK) {
        ESP_LOGE(TAG, "SSD1306 init failed at 0x%02X (err=0x%x)", i2c_addr, ret);
        return ret;
    }
    memset(s_fb, 0, sizeof(s_fb));
    display_flush();
    ESP_LOGI(TAG, "SSD1306 ready at 0x%02X", i2c_addr);
    return ESP_OK;
}

void display_clear(void)
{
    memset(s_fb, 0, sizeof(s_fb));
}

void display_puts(uint8_t col, uint8_t row, const char *s)
{
    if (row >= SSD1306_PAGES) return;
    int x = col * CHAR_W;
    while (*s && x + CHAR_W <= SSD1306_W) {
        uint8_t c = (uint8_t)*s++;
        if (c < 0x20 || c > 0x7F) c = 0x20;
        const uint8_t *glyph = s_font[c - 0x20];
        for (int i = 0; i < FONT_W; i++)
            s_fb[row][x + i] = glyph[i];
        s_fb[row][x + FONT_W] = 0x00;   /* spacing column */
        x += CHAR_W;
    }
}

void display_printf(uint8_t col, uint8_t row, const char *fmt, ...)
{
    char buf[DISPLAY_COLS + 1];
    va_list ap;
    va_start(ap, fmt);
    vsnprintf(buf, sizeof(buf), fmt, ap);
    va_end(ap);
    display_puts(col, row, buf);
}

void display_flush(void)
{
    /* Two transactions per page: 4-byte command then data.
     * SH1106 GDDRAM has 132 columns; visible area is columns 2-129.
     * Write from column 0 with two zero-padding bytes so columns 0-1
     * (non-visible) are always cleared — no leftover GDDRAM garbage. */
    static uint8_t cmd_buf[4];
    static uint8_t data_buf[3 + SSD1306_W];   /* ctrl + 2 pad + 128 pixels */

    for (uint8_t page = 0; page < SSD1306_PAGES; page++) {
        cmd_buf[0] = 0x00;
        cmd_buf[1] = (uint8_t)(0xB0 | page);
        cmd_buf[2] = 0x00;   /* start at SH1106 GDDRAM column 0 */
        cmd_buf[3] = 0x10;
        if (i2c_master_transmit(s_dev, cmd_buf, sizeof(cmd_buf), 50) != ESP_OK) {
            ESP_LOGE(TAG, "flush cmd failed p=%d — bus reset", page);
            i2c_master_bus_reset(s_bus);
            oled_cmd(s_init_seq, sizeof(s_init_seq));
            return;
        }

        data_buf[0] = 0x40;
        data_buf[1] = 0x00;   /* GDDRAM col 0: not visible on SH1106 */
        data_buf[2] = 0x00;   /* GDDRAM col 1: not visible on SH1106 */
        memcpy(data_buf + 3, s_fb[page], SSD1306_W);
        if (i2c_master_transmit(s_dev, data_buf, sizeof(data_buf), 200) != ESP_OK) {
            ESP_LOGE(TAG, "flush data failed p=%d — bus reset", page);
            i2c_master_bus_reset(s_bus);
            oled_cmd(s_init_seq, sizeof(s_init_seq));
            return;
        }
    }
}
